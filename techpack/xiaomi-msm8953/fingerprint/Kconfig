## techpack/xiaomi-msm8953/fingerprint/Kconfig
```kconfig
source "techpack/xiaomi-msm8953/fingerprint/fpc/Kconfig"
source "techpack/xiaomi-msm8953/fingerprint/fpc_ysl/Kconfig"
source "techpack/xiaomi-msm8953/fingerprint/goodix/Kconfig"
source "techpack/xiaomi-msm8953/fingerprint/goodix_ysl/Kconfig"
source "techpack/xiaomi-msm8953/fingerprint/goodix_vince/Kconfig"
```

## techpack/xiaomi-msm8953/fingerprint/fpc_rosy/Kconfig
```kconfig
config FINGERPRINT_FPC1020_ROSY
	tristate "FPC1020 fingerprint driver"
	depends on INPUT_FINGERPRINT
	help
	  Say Y here to enable goodix fingerprint driver support!
```

## techpack/xiaomi-msm8953/fingerprint/goodix_rosy/Kconfig
```kconfig
config FINGERPRINT_GF3208_ROSY
	tristate "GF3208 fingerprint driver"
	depends on INPUT_FINGERPRINT
	help
	  add support for goodix fingerprint driver.
```
